## conf/distro/can-box-rootfs.conf
```bitbake
include conf/machine/include/can-box.inc

DISTRO_NAME = "Custom Rootfs for CAN-Box"
DISTRO_VERSION = "1.0.0"

MAINTAINER = "Flaviu Nistor <flaviu.nistor@gmail.com>"

INIT_MANAGER = "systemd"

#PREFERRED_VERSION_linux-raspberrypi = "6.12%"

IMAGE_FSTYPES += "wic"

#DISTRO_EXTRA_RDEPENDS = ""
#DISTRO_EXTRA_RRECOMMENDS = ""

#DISTRO_FEATURES = ""

#NO_RECOMMENDATIONS = "1"
```

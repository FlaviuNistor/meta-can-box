## conf/layer.conf
```bitbake
# We have a conf and classes directory, add to BBPATH
BBPATH .= ":${LAYERDIR}"

# We have recipes-* directories, add to BBFILES
BBFILES += "${LAYERDIR}/recipes-*/*/*.bb \
            ${LAYERDIR}/recipes-*/*/*.bbappend"

BBFILE_COLLECTIONS += "meta-can-box"
BBFILE_PATTERN_meta-can-box = "^${LAYERDIR}/"
BBFILE_PRIORITY_meta-can-box = "6"

LAYERDEPENDS_meta-can-box = "core"
LAYERSERIES_COMPAT_meta-can-box = "scarthgap"
```
